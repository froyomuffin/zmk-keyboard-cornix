## boards/jzf/cornix/cornix_right_defconfig
```kconfig
# SPDX-License-Identifier: MIT

CONFIG_ADC_NRFX_SAADC=y

# Enable MPU
CONFIG_ARM_MPU=y

# Use pinctrl
CONFIG_PINCTRL=y

# enable GPIO
CONFIG_GPIO=y

CONFIG_USE_DT_CODE_PARTITION=y
CONFIG_BUILD_OUTPUT_UF2=y

CONFIG_MPU_ALLOW_FLASH_WRITE=y
CONFIG_NVS=y
CONFIG_SETTINGS_NVS=y
CONFIG_FLASH=y
CONFIG_FLASH_PAGE_LAYOUT=y
CONFIG_FLASH_MAP=y
CONFIG_CLOCK_CONTROL_NRF=y
CONFIG_CLOCK_CONTROL_NRF_K32SRC_RC=y

CONFIG_ZMK_SPLIT=y

CONFIG_ZMK_KEYBOARD_NAME="CornixR"
CONFIG_ZMK_BLE=y
CONFIG_ZMK_BLE_EXPERIMENTAL_CONN=y

# BLE TX power for reliability
CONFIG_BT_CTLR_TX_PWR_PLUS_8=y

# 电池电量报告间隔时间单位是秒
CONFIG_ZMK_BATTERY_REPORT_INTERVAL=60

# never output usb
CONFIG_ZMK_USB=n

CONFIG_INPUT=y

CONFIG_ZMK_POINTING=y

# enable deep sleep support
CONFIG_ZMK_SLEEP=y
# idle sleep timeout
CONFIG_ZMK_IDLE_SLEEP_TIMEOUT=3600000

# RGB
#CONFIG_SPI=n
#CONFIG_ZMK_EXT_POWER=n

CONFIG_EC11=y
CONFIG_EC11_TRIGGER_GLOBAL_THREAD=y

# vim: set ft=kconfig:
```

## boards/shields/cornix_dongle_xiao/Kconfig.shield
```kconfig
config SHIELD_CORNIX_DONGLE_XIAO
	def_bool $(shields_list_contains,cornix_dongle_xiao)

#vim: set ft=kconfig:
```
